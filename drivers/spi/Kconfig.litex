## dts/bindings/i2c/nxp,imx-i2c.yaml
```yaml
description: i.MX 8M Mini I2C node

compatible: "nxp,imx-i2c"

include: ["i2c-controller.yaml", "pinctrl-device.yaml"]

properties:
  reg:
    required: true

  interrupts:
    required: true

  pinctrl-0:
    required: true
```
