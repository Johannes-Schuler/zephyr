## CMakeLists.txt
```
# SPDX-License-Identifier: Apache-2.0

cmake_minimum_required(VERSION 3.20.0)
find_package(Zephyr REQUIRED HINTS $ENV{ZEPHYR_BASE})
project(cap_initiator)

target_sources(app PRIVATE
  src/main.c
<<<<<<< HEAD
  src/cap_initiator_unicast.c
)

=======
  src/cap_initiator_tx.c
)

zephyr_sources_ifdef(CONFIG_SAMPLE_UNICAST src/cap_initiator_unicast.c)
zephyr_sources_ifdef(CONFIG_SAMPLE_BROADCAST src/cap_initiator_broadcast.c)

>>>>>>> 72dd6bb55432e5fd641ac3b93179a1186ed97911
zephyr_library_include_directories(${ZEPHYR_BASE}/samples/bluetooth)
```

## prj.conf
```kconfig
<<<<<<< HEAD
CONFIG_BT=y
CONFIG_LOG=y
CONFIG_BT_CENTRAL=y
=======
CONFIG_LOG=y
CONFIG_MAIN_STACK_SIZE=2048

CONFIG_BT=y
>>>>>>> 72dd6bb55432e5fd641ac3b93179a1186ed97911
CONFIG_BT_AUDIO=y
CONFIG_BT_EXT_ADV=y
CONFIG_BT_DEVICE_NAME="CAP Initiator"

<<<<<<< HEAD
CONFIG_BT_SMP=y
CONFIG_BT_TINYCRYPT_ECC=y
CONFIG_BT_KEYS_OVERWRITE_OLDEST=y

# CAP support
CONFIG_BT_CAP_INITIATOR=y

# CSIP support
CONFIG_BT_CSIP_SET_COORDINATOR=y

# BAP support
CONFIG_BT_ISO_MAX_CHAN=2
CONFIG_BT_BAP_UNICAST_CLIENT=y
=======
# CAP support
CONFIG_BT_CAP_INITIATOR=y

# BAP support
CONFIG_BT_ISO_MAX_CHAN=2

# Unicast client values if enabled by CONFIG_SAMPLE_UNICAST
>>>>>>> 72dd6bb55432e5fd641ac3b93179a1186ed97911
CONFIG_BT_BAP_UNICAST_CLIENT_GROUP_STREAM_COUNT=2
CONFIG_BT_BAP_UNICAST_CLIENT_ASE_SNK_COUNT=2
CONFIG_BT_BAP_UNICAST_CLIENT_ASE_SRC_COUNT=2

<<<<<<< HEAD
# Controller configuration
CONFIG_BT_CTLR_CENTRAL_ISO=y

# Supports the highest SDU size required by any BAP LC3 presets (155)
CONFIG_BT_CTLR_ISO_TX_BUFFER_SIZE=155
=======
# Broadcast sources values if enabled by CONFIG_SAMPLE_BROADCAST
CONFIG_BT_BAP_BROADCAST_SRC_STREAM_COUNT=2
CONFIG_BT_BAP_BROADCAST_SRC_SUBGROUP_COUNT=1
>>>>>>> 72dd6bb55432e5fd641ac3b93179a1186ed97911
```

## overlay-bt_ll_sw_split.conf
```kconfig
# Zephyr Bluetooth Controller
CONFIG_BT_LL_SW_SPLIT=y

# Zephyr Controller tested maximum advertising data that can be set in a single HCI command
CONFIG_BT_CTLR_SCAN_DATA_LEN_MAX=191
<<<<<<< HEAD

# Enable support for central ISO in Zephyr Bluetooth Controller
CONFIG_BT_CTLR_CENTRAL_ISO=y
=======
CONFIG_BT_CTLR_ADV_DATA_LEN_MAX=191
>>>>>>> 72dd6bb55432e5fd641ac3b93179a1186ed97911

# Support the highest SDU size required by any BAP LC3 presets (155) + 8 bytes of HCI ISO Data
# packet overhead (the Packet_Sequence_Number, ISO_SDU_Length, Packet_Status_Flag fields; and
# the optional Time_Stamp field, if supplied)
CONFIG_BT_CTLR_ISO_TX_BUFFER_SIZE=163
```

## src/main.c
```c
/*
 * Copyright (c) 2024 Nordic Semiconductor ASA
 *
 * SPDX-License-Identifier: Apache-2.0
 */

#include <autoconf.h>
#include <stddef.h>

#include <zephyr/bluetooth/bluetooth.h>
#include <zephyr/kernel.h>
#include <zephyr/logging/log.h>
#include <zephyr/logging/log_core.h>
#include <zephyr/sys/util_macro.h>

#include "cap_initiator.h"

LOG_MODULE_REGISTER(cap_initiator, LOG_LEVEL_INF);

int main(void)
{
	int err;

	err = bt_enable(NULL);
	if (err != 0) {
		LOG_ERR("Bluetooth enable failed: %d", err);

		return 0;
	}

	LOG_INF("Bluetooth initialized");

<<<<<<< HEAD
	/* TODO: Add CAP initiator broadcast support*/

	/* If the CONFIG_BT_CAP_INITIATOR_UNICAST is enabled we call the cap_initiator_unicast
=======
	/* Broadcast is started first as the unicast part is run as loop */
	if (IS_ENABLED(CONFIG_SAMPLE_BROADCAST)) {
		err = cap_initiator_broadcast();

		if (err != 0) {
			LOG_ERR("Failed to run CAP Initiator as broadcaster: %d", err);
		}
	}

	/* If the CONFIG_SAMPLE_UNICAST is enabled we call the cap_initiator_unicast
>>>>>>> 72dd6bb55432e5fd641ac3b93179a1186ed97911
	 * function that runs the application as a CAP Initiator for unicast. This will attempt to
	 * scan for and connect to a CAP acceptor to set up a stream
	 *
	 * Since cap_initiator_unicast runs as a while (true) loop, this shall be done as the last
	 * thing in this function
	 */
<<<<<<< HEAD
	if (IS_ENABLED(CONFIG_BT_CAP_INITIATOR_UNICAST)) {
		err = cap_initiator_unicast();
	}

	if (err != 0) {
		LOG_ERR("Failed to run CAP Initiator: %d", err);
=======
	if (IS_ENABLED(CONFIG_SAMPLE_UNICAST)) {
		err = cap_initiator_unicast();

		if (err != 0) {
			LOG_ERR("Failed to run CAP Initiator as unicast: %d", err);
		}
>>>>>>> 72dd6bb55432e5fd641ac3b93179a1186ed97911
	}

	return 0;
}
```

## src/cap_initiator.h
```c
/*
 * Copyright (c) 2024 Nordic Semiconductor ASA
 *
 * SPDX-License-Identifier: Apache-2.0
 */
<<<<<<< HEAD
=======
#include <stdint.h>

#include <zephyr/bluetooth/audio/bap.h>
#include <zephyr/bluetooth/audio/cap.h>
#include <zephyr/bluetooth/conn.h>

struct tx_stream {
	struct bt_cap_stream *stream;
	uint16_t seq_num;
};
>>>>>>> 72dd6bb55432e5fd641ac3b93179a1186ed97911

/**
 * @brief Run the application as a CAP Initiator for unicast
 *
 * This will start scanning for and connecting to a CAP acceptor, and then attempt to setup
 * unicast streams.
 *
 * @return 0 if success, errno on failure.
 */
int cap_initiator_unicast(void);
<<<<<<< HEAD
=======

/**
 * @brief Run the application as a CAP Initiator for broadcast
 *
 * This will start advertising broadcast audio that CAP acceptors can synchronize to.
 *
 * @return 0 if success, errno on failure.
 */
int cap_initiator_broadcast(void);

/**
 * @brief Initialize TX
 *
 * This will initialize TX if not already initialized. This creates and starts a thread that
 * will attempt to send data on all streams registered with cap_initiator_tx_register_stream().
 */
void cap_initiator_tx_init(void);

/**
 * @brief Register a stream for TX
 *
 * This will add it to the list of streams the TX thread will attempt to send on.
 *
 * @retval 0 on success
 * @retval -EINVAL if @p cap_stream is NULL
 * @retval -ENOMEM if not more streams can be registered
 */
int cap_initiator_tx_register_stream(struct bt_cap_stream *cap_stream);

/**
 * @brief Unregister a stream for TX
 *
 * This will remove it to the list of streams the TX thread will attempt to send on.
 *
 * @retval 0 on success
 * @retval -EINVAL if @p cap_stream is NULL
 * @retval -EALREADY if the stream is currently not registered
 */
int cap_initiator_tx_unregister_stream(struct bt_cap_stream *cap_stream);
>>>>>>> 72dd6bb55432e5fd641ac3b93179a1186ed97911
```
